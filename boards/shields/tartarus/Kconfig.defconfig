## boards/shields/tartarus/Kconfig.defconfig
```kconfig
if SHIELD_TARTARUS

config ZMK_KEYBOARD_NAME
    default "Tartarus Mod"

config ZMK_SPLIT
    default y

endif # SHIELD_TARTARUS
```

## boards/shields/tartarus_dongle/Kconfig.shield
```kconfig
config SHIELD_TARTARUS_DONGLE
    def_bool $(shields_list_contains,tartarus_dongle)
```

## config/west.yml
```yaml
manifest:
  defaults:
    revision: v0.3
  remotes:
    - name: zmkfirmware
      url-base: https://github.com/zmkfirmware
    # Additional modules containing boards/shields/custom code can be listed here as well
    # See https://docs.zephyrproject.org/3.2.0/develop/west/manifest.html#projects
    - name: zmk-studio 
      url-base: https://github.com/zmk-studio
  projects:
    - name: zmk
      remote: zmkfirmware
      import: app/west.yml
    - name: zmk-studio
      remote: zmk-studio
      revision: main
  self:
    path: config
```
